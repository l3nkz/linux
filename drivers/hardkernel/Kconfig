## drivers/hardkernel/Kconfig
```kconfig
menuconfig HARDKERNEL
        tristate "ODROID Specific Hardware"
        help
          Say Y here if you want support odroid devices 

if HARDKERNEL

config ODROID_EXYNOS5_SP
	tristate "Enable the INA231 Sensor on ODROID-EXYNOS5"
	default n
	help
		Enables the INA231 Sensor on ODROID-EXYNOS5

endif
```
